#define LED_PIN 10      // riba1 pin
#define LED_PIN2 12     // riba2 pin
#define LED_NUM 138    // LED1 arv
#define LED_NUM2 162   // LED2 arv
#define LED_BR 150     // riba heledus
#define PIN_AUDIO 11   // heli pin
#define MAX_SPEED 20  // max kiirus
#define MIN_SPEED 2   // max kiirus pööramise ajal
#define TURN_ZONES 2  // pöörete arv
#define TURN_MIN 10   // min pööramise pikkus
#define TURN_MAX 20   // max pööramise pikkus
#define BOOST_ZONES 3 // boost-ide arv
#define BOOST_SIZE 2  // boost-ide pikkus

#include "FastLED.h"
#include "PCM.h"
#include "LiquidCrystal.h"

const byte controlPins[] = {2, 4, 6, 8}; // LED-ide ja nuppude pinide arv vastab mängijate arvule
          // colorPins[] = {3, 5, 7, 9};
const byte players = sizeof(controlPins); // massiivi suurus == колво mängijate arv
CRGB leds[LED_NUM];
CRGB leds2[LED_NUM2];
CRGB playerLeds[players][1];
int turns[TURN_ZONES][2];
int boosts[BOOST_ZONES];
CRGB turnColor = CRGB(30, 5, 0);
CRGB boostColor = CRGB(0, 30, 0);
//LiquidCrystal lcd(RS,  E, D4, D5, D6, D7); 
  LiquidCrystal lcd(A0, A1, A2, A3, A4, A5);

const unsigned char roar[] PROGMEM = { // mootori heli
  126, 128, 128, 128, 127, 127, 128, 128, 127, 128, 128, 125,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 138
};

// ========== ПЕРЕМЕННЫЕ ==========
int pos[players];       // sprite-ide asukoht
int spd[players];       // sprite-ide kiirus
int score[players];     // skoor
bool drag[players];     // pidurdamise lipp
int LAPS = 1;   // võidu skoor
int curLap; // praegune ring
bool buttonPrev[players]; // nuppude eelnevad väärtused
int butPres[players];
bool activePlr[] = {0,0,0,0}; // aktiivsed mängijad

// ============ SETUP =============
void setup() {  
  lcd.begin(16,2);
  lcd.clear();
  FastLED.setBrightness(LED_BR);
  FastLED.addLeds<WS2812, LED_PIN, GRB>(leds, LED_NUM);
  FastLED.addLeds<WS2812, LED_PIN2, GRB>(leds2, LED_NUM2);
  FastLED.addLeds<WS2812, 3, GRB>(playerLeds[0], 1);
  FastLED.addLeds<WS2812, 5, GRB>(playerLeds[1], 1);
  FastLED.addLeds<WS2812, 7, GRB>(playerLeds[2], 1);
  FastLED.addLeds<WS2812, 9, GRB>(playerLeds[3], 1);
  FastLED.clear();
  FastLED.show();
  screen("    Formula","      LED",0);
  startPlayback(roar, sizeof(roar));
  delay(2000);
  
  randomSeed(analogRead(0));              // parandame randomaiseri
  int turnSize = (LED_NUM+LED_NUM2) / TURN_ZONES;    // ploki pikkus kui LED-ide arv/pöörete arv
  for (int t = 0; t < TURN_ZONES; t++) {  // pöörete arvu jaoks
    // otsime pöörde algust iga ringi alguses
    turns[t][0] = random(t * turnSize, (t + 1) * turnSize - TURN_MAX);

    // otsime pöörde lõppu, lisades pikkust algusele
    turns[t][1] = turns[t][0] + random(TURN_MIN, TURN_MAX);
  }
  
  int boostSize = (LED_NUM+LED_NUM2) / BOOST_ZONES;    // ploki pikkus kui LED-ide arv/boost-ide arv
  for (int b = 0; b < BOOST_ZONES; b++) {  // boost-ide arvu jaoks
    // otsime boost-i algust iga ringi alguses
    boosts[b] = random(b * boostSize, (b + 1) * boostSize - BOOST_SIZE);
  }

  for(int i = 0; i < players; i++){
    buttonPrev[i] = 0;
  }

  newGame();    // alustada uus mäng 
  lapsSetup();  // seadistada ringide arv 
  start_signal();
}

// ============= LOOP =============
void loop() {
  static uint32_t tmr, tmr2, tmr3;
  for (int p = 0; p < players; p++) {         // iga mängija jaoks  
      if (buttonPrev[p] == 1 &&  !digitalRead(controlPins[p])){
        butPres[p]++;
        buttonPrev[p] = digitalRead(controlPins[p]);
        delay(3);
      }
  }
  // kiiruse ümberarvutus
  // taimer 200 ms
  if (millis() - tmr2 >= 200) {
    tmr2 = millis();
    screen("      LAP","       ",curLap);
    for (int p = 0; p < players; p++) {         // iga mängija jaoks 
      if(activePlr[p]){
        if (butPres[p]) {
          spd[p] += 3*butPres[p];   // kui nupp on vajutatud - kiirendus
          butPres[p] = 0;
        }
        else spd[p]--;                            // muidu - pidurdamine
        buttonPrev[p] = digitalRead(controlPins[p]);
        // max kiiruse piiramine
        spd[p] = constrain(spd[p], 0, drag[p] ? MIN_SPEED : MAX_SPEED);
      }
    }
  }

  // sprite-ide liikumine
  // taimer 10 ms
  if (millis() - tmr >= 10) {   
    tmr = millis();
    FastLED.clear();  // riba puhastamine
    // teeme pöördeid ja boost-e nähtavaks
    for (int t = 0; t < TURN_ZONES; t++) {              // kõikide pöörete jaoks
      for (int s = turns[t][0]; s < turns[t][1]; s++) {
        if(s<LED_NUM){
          leds[s] = turnColor;    // omistame piksilise värv
        }
        else{
          leds2[LED_NUM+LED_NUM2-s] = turnColor;
        }
      }
    }

    for (int b = 0; b < BOOST_ZONES; b++) {              // kõikide boost-ide jaoks
      for (int s = boosts[b]; s < (boosts[b] + BOOST_SIZE); s++) {
        if(s<LED_NUM){
          leds[s] = boostColor;    // omistame pikslile värv
        }
        else{
          leds2[LED_NUM+LED_NUM2-s] = boostColor;
        }
      }
    }

    // käime läbi kõik mängijad
    for (int p = 0; p < players; p++) {
      if(activePlr[p]){
        pos[p] += spd[p];   // liigume vastava kiirusega
      
        if (buttonPrev[p]==1 && !digitalRead(controlPins[p])) {  // kui nupp on vajutatud
          for (int t = 0; t < TURN_ZONES; t++) {    // pöörete kontroll
            // sprite on pöördes
            if (pos[p] / 10 >= turns[t][0] && pos[p] / 10 < turns[t][1]) {
              drag[p] = 1;            // kiiruse pidurdamise lipp
              spd[p] = MIN_SPEED;     // piirame kiirust
            } else drag[p] = 0;       // nupp pole vajutatud - piirangud maha
          }

          for (int b = 0; b < BOOST_ZONES; b++) {    // pöörete kontroll
            // sprite on pöördes
            if (pos[p] / 10 >= boosts[b] && pos[p] / 10 < (boosts[b] + BOOST_SIZE)) {
              spd[p] += 5;     // piirame kiirust
              for (int t = 0; t < TURN_ZONES; t++) {
                if (pos[p] / 10 >= turns[t][0] && pos[p] / 10 < turns[t][1]) {
                  spd[p] += 10;
                }
              } 
            }
          }
        } else drag[p] = 0;       // nupp pole vajutatud - piirangud maha
              
        // kas jõudsime lõppu?
        if (pos[p] >= ((LED_NUM+LED_NUM2) * 10)) {   // riba lõppes, ring on labi
          pos[p] -= (LED_NUM+LED_NUM2) * 10;         // ring--
          score[p]++;                     // skoor +1
          if(score[p]>=curLap){
              curLap++;
              screen("      LAP","       ",curLap);
              if(curLap == LAPS-1)
                  screen("     FINAL","      LAP!",0);
          }
          
          // võidu skoo ron saavutatud
          if (score[p] >= LAPS) {
            winner(p);
            newGame();
            lapsSetup();
            start_signal();
            return;   // uus tsukkel
          }
        }

        // kui pole võitja - sinu värvi salvestab üks LED
        if(pos[p]<(LED_NUM*10)){
          leds[pos[p] / 10].setHue(p * 255 / players);
        }
        else{
          leds2[((LED_NUM2+LED_NUM)*10 - pos[p]) / 10].setHue(p * 255 / players);
        }
        buttonPrev[p] = digitalRead(controlPins[p]);
        playerLeds[p][0].setHue(p * 255 / players);
      }  
    }   // END
    FastLED.show();
  } // END of timer
}

// ===== Additonal functions ======
void start_signal() {
  for(int i = 2; i < 10; i += 3){
    int count = 4-((i+1)/3);
    screen("     Ready!","       ",count);
    leds[i].setHue(0);
    FastLED.show();
    tone(PIN_AUDIO, 2637,200);
    delay(1000);
    noTone(PIN_AUDIO);
  }
  for(int i = 2; i < 10; i += 3){
    leds[i].setHue(96);
    FastLED.show();
  }
  screen("      GO!","",0);
  tone(PIN_AUDIO, 3000,400);
  delay(400);
  noTone(PIN_AUDIO);
  FastLED.clear();
}

void newGame() {
  int i = 0;
  bool start = 0;

    // skoor = 0 ja kiirus = 0
  for (int np = 0; np < players; np++) {
    drag[np] = pos[np] = spd[np] = score[np] = 0;
  }

  screen(" Waiting for","   Players   0",0);
  for (int p = 0; p < players; p++){
      pinMode(controlPins[p], INPUT);
      buttonPrev[p] = 1;
  }
  while(!start){
    for (int p = 0; p < players; p++){
      if(!activePlr[p]){
        if(digitalRead(controlPins[p])){    // nuppude initsialiseerimine
        delay(500);
          buttonPrev[p] = digitalRead(controlPins[p]);
          tone(PIN_AUDIO, 2637,50);
          activePlr[p] = 1;
          i++;
          screen("Waiting for","Players   ",i);
          playerLeds[p][0].setHue(p * 255 / players);
          FastLED.show();
        }
      }
      if(activePlr[p]){
        delay(50);
        if(buttonPrev[p] == 1 && !digitalRead(controlPins[p])){
          start = 1;
          delay(50);
          buttonPrev[p] = digitalRead(controlPins[p]);
          break;
        } 
      }
    }
  }
  startPlayback(roar, sizeof(roar));
  delay(2000);
}

void winner(int p) {
  screen(" The Winer Is:","  Player  ",p + 1);
  FastLED.clear();
  startPlayback(roar, sizeof(roar));
  delay(2000);
  // ribale omistatakse võitja värv
  for (int led = 0; led < (LED_NUM+LED_NUM2); led+=3) {
    (led<LED_NUM) ? leds[led].setHue(p * 255 / players) : leds2[LED_NUM2+LED_NUM-led].setHue(p * 255 / players);
    FastLED.show();
    delay(10);
  }
  FastLED.clear();
  FastLED.show();
  while(1){
    for(int p = 0; p < players; p++){
      if (!digitalRead(controlPins[p])) {
        delay(50);
        return;
      }
    }
  }
}

void screen (char buf1[],char buf2[],int number){
  lcd.clear();
  lcd.setCursor(0,0);
  lcd.print(buf1);
  lcd.setCursor(0,1);
  lcd.print(buf2);
  if(number){
    lcd.print(number);
  }
}

void lapsSetup(){
  int a1, a2;
  bool start = 0; 
  curLap = 1;
  tone(PIN_AUDIO, 2637,50);
  a1=analogRead(A7);
  LAPS=(a1+100)/100;
  screen("      Laps","       ",LAPS);
  for(int p = 0; p < players; p++){
      buttonPrev[p] = digitalRead(controlPins[p]);
  }
  while(!start) {
    delay(100);
    a2=analogRead(A7);
    if(abs(a1-a2)>50){
      a1=a2;
      if(LAPS!=(a2+100)/100){
        LAPS=(a2+100)/100;
        tone(PIN_AUDIO, 2637,50);
        screen("      Laps","       ",LAPS);
      }
    }
    
    for(int p = 0; p < players; p++){
      if(activePlr[p]){ 
        if(buttonPrev[p] != digitalRead(controlPins[p])){
          delay(50);
          start = 1;
          buttonPrev[p] = digitalRead(controlPins[p]);
        } 
      }
    }
  }
  noTone(PIN_AUDIO);
  startPlayback(roar, sizeof(roar));
  delay(2000);
}
